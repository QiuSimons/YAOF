// SPDX-License-Identifier: (GPL-2.0+ OR MIT)
/*
 * Copyright (c) 2021 Rockchip Electronics Co., Ltd.
 *
 */

/dts-v1/;

/ {
	model = "HINLINK OPC-H69K Board";
	compatible = "hinlink,opc-h69k", "rockchip,rk3568";
};
