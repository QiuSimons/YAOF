// SPDX-License-Identifier: (GPL-2.0+ OR MIT)
// Copyright (c) 2022 AmadeusGhost <amadeus@jmu.edu.cn>

/dts-v1/;

/ {
	model = "Radxa ROCK Pi E25";
	compatible = "radxa,rockpi-e25", "rockchip,rk3568";
};
